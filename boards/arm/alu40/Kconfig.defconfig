## boards/arm/alu40/Kconfig.defconfig
```kconfig
# Copyright (c) 2021 Polarity Works
# SPDX-License-Identifier: MIT

if BOARD_ALU40

config BOARD
	default "alu40"

if USB

config USB_NRFX
	default y

config USB_DEVICE_STACK
	default y

endif # USB

config BT_CTLR
	default BT

config ZMK_BLE
	default y

config ZMK_USB
	default y

config ZMK_BATTERY_VOLTAGE_DIVIDER
	default y

config ZMK_KEYBOARD_NAME
	default "ALU40"

endif # BOARD_ALU40
```

## config/boards/arm/alu40/Kconfig.board
```kconfig
# ALU40 board configuration

# Copyright (c) 2022 Polarity Works
# SPDX-License-Identifier: MIT

config BOARD_ALU40
	bool "alu40"
	depends on SOC_NRF52840_QIAA
```

## config/west.yml
```yaml
manifest:
  remotes:
    - name: zmkfirmware
      url-base: https://github.com/zmkfirmware
  projects:
    - name: alu40-module
      url: https://github.com/polarityworks/zmk-config-alu40
      revision: main
      clone-depth: 1
    - name: zmk
      remote: zmkfirmware
      revision: main
      import: app/west.yml
  self:
    path: config
```
